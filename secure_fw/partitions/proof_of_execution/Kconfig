## secure_fw/partitions/proof_of_execution/Kconfig
```kconfig
#-------------------------------------------------------------------------------
# SPDX-FileCopyrightText: Copyright The TrustedFirmware-M Contributors
# SPDX-License-Identifier: BSD-3-Clause
#
#-------------------------------------------------------------------------------

menuconfig TFM_PARTITION_PROOF_OF_EXECUTION
    bool "Proof of Execution"
    depends on TFM_PARTITION_INITIAL_ATTESTATION
    default n

if TFM_PARTITION_PROOF_OF_EXECUTION

config POX_ALLOW_RUNTIME_KEY_OVERRIDE
    bool "Allow runtime override of the PoX signing key"
    default n
    help
      If enabled, compiles in pox_set_signing_key(), which lets a
      caller (e.g. a test partition) replace the hardcoded PoX
      signing key at runtime with a 32-byte ECDSA P-256 private
      scalar.

      Leave this disabled in production: the only signer should be
      the key hardcoded in pox_key.c.

config POX_ALLOW_PLACEHOLDER_KEY
    bool "Allow the placeholder PoX signing key (UNSAFE)"
    default n
    depends on TFM_BUILD_TYPE_DEBUG
    help
      The placeholder key shipped in pox_key.c is publicly known and
      must never be used in production. By default the build will fail
      with a hard error if the key has not been replaced.

      Enable this option ONLY for initial bring-up or CI builds where
      a real key is not yet available. It is intentionally restricted
      to debug builds (TFM_BUILD_TYPE_DEBUG) and cannot be set in
      release configurations.

      NEVER enable this on a production device.

config POX_REQUEST_AUTH
    bool "PoX request authentication (verifier-signed requests)"
    default y
    select TFM_PARTITION_INTERNAL_TRUSTED_STORAGE
    help
      The verifier signs each request transcript
      (ver | session_id | nonce | faddr | boot epoch | seq) with its
      ECDSA P-256 private key, and the partition verifies it with the
      embedded verifier public key before any PoX processing.

      Enforcement rules:
        - Invalid signature -> request rejected.
        - Replay            -> request rejected: the verifier assigns
          each request a strictly increasing sequence number, and the
          partition keeps only the per-boot high-water mark (4 bytes
          of RAM).

      A monotonically increasing boot epoch counter is kept in ITS
      (one small write per boot - O(boots), never O(requests)) and
      bound into the signed transcript, so an authorization captured
      before a reboot dies with that boot. The epoch is also emitted
      as a token claim (POX_LABEL_BOOT_EPOCH).

      The partition stores no session secret (public key only). When
      enabled, requests without credentials are rejected with
      PSA_ERROR_NOT_PERMITTED. The ITS service must be in the
      dependencies list of tfm_proof_of_execution.yaml.

config POX_SYMMETRIC_TOKEN
    bool "Protect the PoX token with HMAC-SHA256 (COSE_Mac0)"
    default n
    depends on SYMMETRIC_INITIAL_ATTESTATION
    help
      By default the partition signs its token with its ECDSA P-256
      key (COSE_Sign1), so any party holding the public key can check
      it. With this option it computes HMAC-SHA256 (COSE_Mac0) under a
      symmetric PoX key instead, the way Initial Attestation does with
      a symmetric IAK. This removes the second ECDSA signature from each
      request, but the Verifier must hold the key, so it could forge
      tokens, and third parties cannot check them.

config POX_SYMMETRIC_REQUEST_AUTH
    bool "Authenticate requests with HMAC-SHA256 instead of ECDSA"
    default n
    depends on POX_REQUEST_AUTH
    help
      The Verifier tags each request transcript with HMAC-SHA256 under
      a key it shares with the device (32-byte tag), instead of signing
      it with ECDSA P-256 (64-byte signature). The check is far cheaper,
      but the device must keep the key secret: anyone who extracts it
      can authorize requests, while the ECDSA build holds only a public
      key. Applies to both PoX paths.

config POX_LOG_ENABLE
    bool "PoX debug logging"
    default y
    help
      Compile in the [PoX]/[Attest][PoX] informational and error log
      messages (UART). Disable for benchmarking: with this off every
      log call compiles out entirely, so the instrumented build has
      no logging overhead versus the unmodified baseline.

endif
```

## secure_fw/partitions/proof_of_execution/Kconfig.comp
```kconfig
#-------------------------------------------------------------------------------
# SPDX-FileCopyrightText: Copyright The TrustedFirmware-M Contributors
# SPDX-License-Identifier: BSD-3-Clause
#
#-------------------------------------------------------------------------------

menu "Proof Of Execution"
    depends on TFM_PARTITION_PROOF_OF_EXECUTION
```
