## secure_fw/partitions/initial_attestation/Kconfig
```kconfig
#-------------------------------------------------------------------------------
# SPDX-FileCopyrightText: Copyright The TrustedFirmware-M Contributors
# SPDX-License-Identifier: BSD-3-Clause
#
#-------------------------------------------------------------------------------

menuconfig TFM_PARTITION_INITIAL_ATTESTATION
    bool "Initial attestation"
    depends on TFM_PARTITION_CRYPTO
    default n

if TFM_PARTITION_INITIAL_ATTESTATION

config SYMMETRIC_INITIAL_ATTESTATION
    bool "Symmetric key algorithm based Initial Attestation"
    default n
    help
      Use symmetric crypto for initial attestation

config ATTEST_KEY_BITS
    int "Key bit width"
    default 256
    help
      The size of the initial attestation key in bits

config PSA_INITIAL_ATTEST_MAX_TOKEN_SIZE
    hex  "The maximum possible size of a token"
    default 0x250

config ATTEST_POX
    bool "Proof of Execution inside Initial Attestation"
    default n
    help
      Compile the PoX path (TFM_ATTEST_GET_POX) into this partition:
      wire deserializer, NS function execution and the PoX token
      creation. The standalone PoX partition is independent
      (TFM_PARTITION_PROOF_OF_EXECUTION).

config POX_SESSION_AUTH_ATT
    bool "PoX session authentication on the attestation-partition path"
    default n
    depends on ATTEST_POX
    help
      Enforce verifier-signed session credentials (session_id +
      ECDSA P-256 transcript signature) for TFM_ATTEST_GET_POX
      requests, mirroring POX_SESSION_AUTH in the standalone PoX
      partition but independently switchable. The attestation
      partition keeps its own verifier key handle and nonce ring.
      IAT services are unaffected either way.

endif
```

## secure_fw/partitions/proof_of_execution/Kconfig
```kconfig
#-------------------------------------------------------------------------------
# SPDX-FileCopyrightText: Copyright The TrustedFirmware-M Contributors
# SPDX-License-Identifier: BSD-3-Clause
#
#-------------------------------------------------------------------------------

menuconfig TFM_PARTITION_PROOF_OF_EXECUTION
    bool "Proof of Execution"
    depends on TFM_PARTITION_INITIAL_ATTESTATION
    default n

if TFM_PARTITION_PROOF_OF_EXECUTION

config POX_ALLOW_RUNTIME_KEY_OVERRIDE
    bool "Allow runtime override of the PoX signing key"
    default n
    help
      If enabled, compiles in pox_set_signing_key(), which lets a
      caller (e.g. a test partition) replace the hardcoded PoX
      signing key at runtime with a 32-byte ECDSA P-256 private
      scalar.

      Leave this disabled in production: the only signer should be
      the key hardcoded in pox_key.c.

config POX_ALLOW_PLACEHOLDER_KEY
    bool "Allow the placeholder PoX signing key (UNSAFE)"
    default n
    depends on TFM_BUILD_TYPE_DEBUG
    help
      The placeholder key shipped in pox_key.c is publicly known and
      must never be used in production. By default the build will fail
      with a hard error if the key has not been replaced.

      Enable this option ONLY for initial bring-up or CI builds where
      a real key is not yet available. It is intentionally restricted
      to debug builds (TFM_BUILD_TYPE_DEBUG) and cannot be set in
      release configurations.

      NEVER enable this on a production device.

config POX_SESSION_AUTH
    bool "PoX session authentication (verifier-signed requests)"
    default y
    select TFM_PARTITION_INTERNAL_TRUSTED_STORAGE
    help
      Two-phase protocol: the verifier signs each request transcript
      (ver | session_id | nonce | faddr | boot epoch) with its ECDSA
      P-256 private key, and the partition verifies it with the
      embedded verifier public key before any PoX processing.

      Enforcement rules:
        - Invalid signature -> request rejected, session ended.
        - Replay            -> request rejected (bounded RAM nonce
          ring, or monotonic seq in POX_SEQ_AUTH builds).

      A monotonically increasing boot epoch counter is kept in ITS
      (one small write per boot - O(boots), never O(requests)) and
      bound into the signed transcript, so an authorization captured
      before a reboot dies with that boot: cross-reboot replay is
      structurally closed. The epoch is also emitted as a token claim
      (POX_LABEL_BOOT_EPOCH).

      The partition stores no session secret (public key only). When
      enabled, requests without session credentials are rejected with
      PSA_ERROR_NOT_PERMITTED, so the NS caller must supply session_id
      and sess_sig obtained from the verifier. The ITS service must be
      in the dependencies list of tfm_proof_of_execution.yaml.

config POX_NONCE_HISTORY
    int "Nonce-reuse ring size (entries)"
    default 16
    depends on POX_SESSION_AUTH
    help
      Number of entries in the bounded RAM ring of SHA-256 nonce
      digests used to reject nonce reuse within one boot ("prover's
      book"). Each entry is 32 bytes; 16 entries = 512 bytes of SRAM.
      Size it to at least the number of requests expected per boot
      window in which replay must be detected device-side. The
      verifier's book remains the authoritative replay defence.

config POX_LOG_ENABLE
    bool "PoX debug logging"
    default y
    help
      Compile in the [PoX]/[Attest][PoX] informational and error log
      messages (UART). Disable for benchmarking: with this off every
      log call compiles out entirely, so the instrumented build has
      no logging overhead versus the unmodified baseline.

config POX_SEQ_AUTH
    bool "Monotonic sequence anti-replay (replaces the nonce ring)"
    default n
    depends on POX_SESSION_AUTH
    help
      Transcript v3: the verifier assigns each request a strictly
      increasing sequence number, bound into the signed transcript.
      The partition keeps only the per-boot high-water mark (4 bytes
      of RAM) and accepts a request iff its seq strictly exceeds it,
      so there is no eviction window like the bounded nonce ring.
      In-boot replay is covered by the seq; cross-boot replay by the
      boot epoch that every session-auth build already binds.

endif
```
